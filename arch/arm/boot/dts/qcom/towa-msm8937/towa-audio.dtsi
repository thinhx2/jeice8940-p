/*
 * Copyright (c) 2015, The Linux Foundation. All rights reserved.
 *
 * This program is free software; you can redistribute it and/or modify
 * it under the terms of the GNU General Public License version 2 and
 * only version 2 as published by the Free Software Foundation.
 *
 * This program is distributed in the hope that it will be useful,
 * but WITHOUT ANY WARRANTY; without even the implied warranty of
 * MERCHANTABILITY or FITNESS FOR A PARTICULAR PURPOSE.  See the
 * GNU General Public License for more details.
 */

&soc {
    sound {
        status = "okay";
        compatible = "qcom,msm8952-audio-codec";
        qcom,model = "msm8952-snd-card-mtp";
        qcom,msm-mbhc-hphl-swh = <1>;
        qcom,msm-mbhc-gnd-swh = <0>;
        qcom,msm-hs-micbias-type = "internal";
		qcom,msm-micbias2-ext-cap;
        qcom,aw8737-ctrl-gpio = <&tlmm 63 0x0>;
        qcom,audio-routing =
        "MIC BIAS External", "Handset Mic",
        "MIC BIAS Internal2", "Headset Mic",
        "AMIC1", "MIC BIAS External",
        "AMIC2", "MIC BIAS Internal2";
    };
};

&pm8937_cajon_dig {
    status = "okay";
};

&pm8937_cajon_analog {
    status = "okay";
};
