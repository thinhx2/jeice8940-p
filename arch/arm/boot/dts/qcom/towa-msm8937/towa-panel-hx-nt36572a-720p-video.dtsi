/* Copyright (c) 2013-2015, The Linux Foundation. All rights reserved.
 *
 * This program is free software; you can redistribute it and/or modify
 * it under the terms of the GNU General Public License version 2 and
 * only version 2 as published by the Free Software Foundation.
 *
 * This program is distributed in the hope that it will be useful,
 * but WITHOUT ANY WARRANTY; without even the implied warranty of
 * MERCHANTABILITY or FITNESS FOR A PARTICULAR PURPOSE.  See the
 * GNU General Public License for more details.
 */

&mdss_mdp {
	dsi_nt36572a_720_vid: qcom,mdss_dsi_nt36572a_720p_video {
		qcom,mdss-dsi-panel-name = "nt36572a_hx 720p video mode dsi panel";
		qcom,mdss-dsi-panel-id = <0>;
		qcom,mdss-dsi-panel-type = "dsi_video_mode";
		qcom,panel-supply-entries = <&dsi_panel_pwr_supply>;
		qcom,mdss-dsi-panel-framerate = <60>;
		qcom,mdss-dsi-virtual-channel-id = <0>;
		qcom,mdss-dsi-stream = <0>;
		qcom,mdss-dsi-panel-width = <720>;
		qcom,mdss-dsi-panel-height = <1500>;
		qcom,mdss-dsi-h-front-porch = <300>;
		qcom,mdss-dsi-h-back-porch = <272>;
		qcom,mdss-dsi-h-pulse-width = <4>;
		qcom,mdss-dsi-h-sync-skew = <0>;
		qcom,mdss-dsi-v-back-porch = <12>;
		qcom,mdss-dsi-v-front-porch = <12>;
		qcom,mdss-dsi-v-pulse-width = <2>;             
		qcom,mdss-dsi-h-left-border = <0>;
		qcom,mdss-dsi-h-right-border = <0>;
		qcom,mdss-dsi-v-top-border = <0>;
		qcom,mdss-dsi-v-bottom-border = <0>;
		qcom,mdss-dsi-bpp = <24>;
		qcom,mdss-dsi-underflow-color = <0xff>;
		qcom,mdss-dsi-border-color = <0>;
		qcom,mdss-dsi-on-command = [
          	
           15 01 00 00 00 00 02 FF 20
		15 01 00 00 00 00 02 FB 01
		15 01 00 00 00 00 02 07 A8
		15 01 00 00 00 00 02 0F A4
		15 01 00 00 00 00 02 61 82
		15 01 00 00 00 00 02 62 A2
		15 01 00 00 00 00 02 69 99
		15 01 00 00 00 00 02 6D 44
		//vcom
		//15 01 00 00 00 00 02 89  10

		15 01 00 00 00 00 02 94  00
		//GVDD 5.3V
		15 01 00 00 00 00 02 95 F5
		15 01 00 00 00 00 02 96 F5
		
		15 01 00 00 00 00 02 FF 24
		15 01 00 00 00 00 02 FB 01
		15 01 00 00 00 00 02 00 1C
		15 01 00 00 00 00 02 01 1C
		15 01 00 00 00 00 02 02 1C
		15 01 00 00 00 00 02 03 1C
		15 01 00 00 00 00 02 04 1C
		15 01 00 00 00 00 02 05 1C
		15 01 00 00 00 00 02 06 1C
		15 01 00 00 00 00 02 07 1C
		15 01 00 00 00 00 02 08 1C
		15 01 00 00 00 00 02 09 1C
		15 01 00 00 00 00 02 0A 20
		15 01 00 00 00 00 02 0B 20
		15 01 00 00 00 00 02 0C 10
		15 01 00 00 00 00 02 0D 12
		15 01 00 00 00 00 02 0E 14
		15 01 00 00 00 00 02 0F 1E
		15 01 00 00 00 00 02 10 0D
		15 01 00 00 00 00 02 11 0A
		15 01 00 00 00 00 02 12 01
		15 01 00 00 00 00 02 13 05
		15 01 00 00 00 00 02 14 03
		15 01 00 00 00 00 02 15 04
		15 01 00 00 00 00 02 16 06
		15 01 00 00 00 00 02 17 1C
		15 01 00 00 00 00 02 18 1C
		15 01 00 00 00 00 02 19 1C
		15 01 00 00 00 00 02 1A 1C
		15 01 00 00 00 00 02 1B 1C
		15 01 00 00 00 00 02 1C 1C
		15 01 00 00 00 00 02 1D 1C
		15 01 00 00 00 00 02 1E 1C
		15 01 00 00 00 00 02 1F 1C
		15 01 00 00 00 00 02 20 1C
		15 01 00 00 00 00 02 21 20
		15 01 00 00 00 00 02 22 00
		15 01 00 00 00 00 02 23 10
		15 01 00 00 00 00 02 24 12
		15 01 00 00 00 00 02 25 14
		15 01 00 00 00 00 02 26 1E
		15 01 00 00 00 00 02 27 0D
		15 01 00 00 00 00 02 28 0A
		15 01 00 00 00 00 02 29 01
		15 01 00 00 00 00 02 2A 04
		15 01 00 00 00 00 02 2B 06
		15 01 00 00 00 00 02 2D 03
		15 01 00 00 00 00 02 2F 05
		15 01 00 00 00 00 02 31 04
		15 01 00 00 00 00 02 32 08
		15 01 00 00 00 00 02 33 04
		15 01 00 00 00 00 02 34 08
		15 01 00 00 00 00 02 35 00
		//GCK set 20180320
		15 01 00 00 00 00 02 37 01
		15 01 00 00 00 00 02 38 A7
		15 01 00 00 00 00 02 39 9D
		15 01 00 00 00 00 02 3F 9D
		15 01 00 00 00 00 02 41 04
		15 01 00 00 00 00 02 42 08
		15 01 00 00 00 00 02 4C 09
		15 01 00 00 00 00 02 4D 09
		15 01 00 00 00 00 02 60 51
		15 01 00 00 00 00 02 61 DC
		15 01 00 00 00 00 02 79 22
		//demux-GCK 20180320
		15 01 00 00 00 00 02 7A 0D
		15 01 00 00 00 00 02 7B AA
		15 01 00 00 00 00 02 7D 26
		15 01 00 00 00 00 02 80 42
		15 01 00 00 00 00 02 82 11
		15 01 00 00 00 00 02 83 22
		15 01 00 00 00 00 02 84 33
		15 01 00 00 00 00 02 85 00
		15 01 00 00 00 00 02 86 00
		15 01 00 00 00 00 02 87 00
		15 01 00 00 00 00 02 88 11
		15 01 00 00 00 00 02 89 22
		15 01 00 00 00 00 02 8A 33
		15 01 00 00 00 00 02 8B 00
		15 01 00 00 00 00 02 8C 00
		15 01 00 00 00 00 02 8D 00
		15 01 00 00 00 00 02 92 B2
		15 01 00 00 00 00 02 B3 0A
		15 01 00 00 00 00 02 B4 04
		15 01 00 00 00 00 02 DC 29
		15 01 00 00 00 00 02 DD 03
		15 01 00 00 00 00 02 DE 03
		15 01 00 00 00 00 02 DF 01
		15 01 00 00 00 00 02 E0 9D
		15 01 00 00 00 00 02 EB 10

		15 01 00 00 00 00 02 FF 25
		15 01 00 00 00 00 02 FB 01
		15 01 00 00 00 00 02 21 29
		15 01 00 00 00 00 02 22 29
		15 01 00 00 00 00 02 24 B2
		15 01 00 00 00 00 02 25 B2
		15 01 00 00 00 00 02 28 00
		15 01 00 00 00 00 02 29 B2
		15 01 00 00 00 00 02 2A 00
		15 01 00 00 00 00 02 2B B2
		15 01 00 00 00 00 02 69 60
		15 01 00 00 00 00 02 71 5D
		15 01 00 00 00 00 02 7E 2D
		15 01 00 00 00 00 02 84 78
		15 01 00 00 00 00 02 8D 00
		15 01 00 00 00 00 02 C2 59
		15 01 00 00 00 00 02 C3 13
		//open GCK EQ for notch 
		15 01 00 00 00 00 02 D0 01
		15 01 00 00 00 00 02 D4 00
		15 01 00 00 00 00 02 D5 02
		15 01 00 00 00 00 02 D6 20
		15 01 00 00 00 00 02 D9 88

		15 01 00 00 00 00 02 FF 26
		15 01 00 00 00 00 02 FB 01
		15 01 00 00 00 00 02 06 FF
		15 01 00 00 00 00 02 12 4B
		15 01 00 00 00 00 02 1A 71
		15 01 00 00 00 00 02 1C AF
		15 01 00 00 00 00 02 1E F4
		15 01 00 00 00 00 02 98 F1
		15 01 00 00 00 00 02 AE 48
		15 01 00 00 00 00 02 FF 27
		15 01 00 00 00 00 02 FB 01
		15 01 00 00 00 00 02 13 00
		15 01 00 00 00 00 02 1E 15
		15 01 00 00 00 00 02 FF F0
		15 01 00 00 00 00 02 FB 01
		15 01 00 00 00 00 02 A2 00
		15 01 00 00 00 00 02 FF 10
		15 01 00 00 00 00 02 FF 23
		15 01 00 00 00 00 02 FB 01
		15 01 00 00 00 00 02 00 80   // 80:12BIT PWM 00:8BIT
		15 01 00 00 00 00 02 07 00  
	 	15 01 00 00 00 00 02 08 01   
	 	15 01 00 00 00 00 02 09 00   //80KHz
		15 01 00 00 00 00 02 FF 10
		15 01 00 00 00 00 02 FB 01
		//15 01 00 00 00 00 02 51 FF  //write display brightness
		29 01 00 00 00 00 03 68 04 01   // add by wangshouping@huaqin.com for backlight
		15 01 00 00 00 00 02 53 2C     //add by wangshouping@huaqin.com for backlight
		05 01 00 00 38 00 02 11 00
		05 01 00 00 14 00 02 29 00          			
					];
		qcom,mdss-dsi-off-command = [
		/*05 01 00 00 14 00 02 22 00*/
		
		15 01 00 00 00 00 02 FF 10
           	15 01 00 00 00 00 02 FB 01
		05 01 00 00 14 00 02 28 00
		15 01 00 00 00 00 02 FF 20
           	15 01 00 00 00 00 02 FB 01
          	15 01 00 00 00 00 02 95 0F
          	15 01 00 00 00 00 02 96 0F
           	29 01 00 00 00 00 0D B3 03 FF 03 FF 03 FF 03 FF 03 FF 03 FF
           	29 01 00 00 00 00 0D B7 03 FF 03 FF 03 FF 03 FF 03 FF 03 FF
           	29 01 00 00 00 00 0D BB 03 FF 03 FF 03 FF 03 FF 03 FF 03 FF
		15 01 00 00 00 00 02 FF 21
           	15 01 00 00 00 00 02 FB 01
           	29 01 00 00 00 00 0D B3 03 FF 03 FF 03 FF 03 FF 03 FF 03 FF
           	29 01 00 00 00 00 0D B7 03 FF 03 FF 03 FF 03 FF 03 FF 03 FF
           	29 01 00 00 00 00 0D BB 03 FF 03 FF 03 FF 03 FF 03 FF 03 FF
		15 01 00 00 00 00 02 FF 10
           	15 01 00 00 00 00 02 FB 01
		//05 01 00 00 ff 00 02 28 00
		05 01 00 00 14 00 02 28 00
		05 01 00 00 78 00 02 10 00];  
		qcom,mdss-dsi-on-command-state = "dsi_lp_mode";
		qcom,mdss-dsi-off-command-state = "dsi_lp_mode";
		 qcom,mdss-dsi-panel-status-command = [06 01 00 01 05 00 02 0A 08];
		qcom,mdss-dsi-panel-status-command-state = "dsi_lp_mode";
		qcom,mdss-dsi-panel-status-check-mode = "reg_read";
		qcom,mdss-dsi-panel-status-read-length = <4>;
		qcom,mdss-dsi-panel-status-valid-params = <1> ;
		qcom,mdss-dsi-panel-status-value = <0x9c>;
		qcom,esd-check-enabled;
		qcom,dynamic-mode-switch-enabled;
		qcom,video-to-cmd-mode-switch-commands = [15 01 00 00 14 00 02 C2 0B
					15 01 00 00 00 00 02 C2 08];
		qcom,cmd-to-video-mode-switch-commands = [15 01 00 00 00 00 02 C2 03];
		qcom,mdss-dsi-h-sync-pulse = <1>;
		qcom,mdss-dsi-traffic-mode = "burst_mode";
		qcom,mdss-dsi-bllp-eof-power-mode;
		qcom,mdss-dsi-bllp-power-mode;
		qcom,mdss-dsi-hfp-power-mode;
		qcom,mdss-dsi-lane-0-state;
		qcom,mdss-dsi-lane-1-state;
		qcom,mdss-dsi-lane-2-state;
		qcom,mdss-dsi-lane-3-state;
		qcom,mdss-dsi-panel-timings = [BD 2C 1E 00 58 5C 22 30 25 03 04 00];
		qcom,mdss-dsi-t-clk-post = <0x03>;
		qcom,mdss-dsi-t-clk-pre = <0x24>;
		qcom,mdss-dsi-bl-min-level = <1>;
		qcom,mdss-dsi-bl-max-level = <255>;
		qcom,mdss-dsi-dma-trigger = "trigger_sw";
		qcom,mdss-dsi-mdp-trigger = "none";
		qcom,mdss-dsi-bl-pmic-control-type = "bl_ctrl_dcs";
		qcom,mdss-dsi-reset-sequence = <1 10>, <0 10>, <1 15>;
		qcom,mdss-pan-physical-width-dimension = <68>;
		qcom,mdss-pan-physical-height-dimension = <141>;
		qcom,mdss-dsi-lp11-init;
     
	};  
};   
     
