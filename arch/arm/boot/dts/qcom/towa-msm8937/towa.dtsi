/*
 * Copyright (c) 2015-2016, The Linux Foundation. All rights reserved.
 *
 * This program is free software; you can redistribute it and/or modify
 * it under the terms of the GNU General Public License version 2 and
 * only version 2 as published by the Free Software Foundation.
 *
 * This program is distributed in the hope that it will be useful,
 * but WITHOUT ANY WARRANTY; without even the implied warranty of
 * MERCHANTABILITY or FITNESS FOR A PARTICULAR PURPOSE.  See the
 * GNU General Public License for more details.
 */

#include "towa-camera-sensor.dtsi"
#include "towa-tp.dtsi"
#include "towa-fpc.dtsi"
#include "towa-sensors.dtsi"
#include "towa-audio.dtsi"
#include "towa-battery.dtsi"
#include "towa-usb.dtsi"
#include "towa-mdss-panels.dtsi"
#include "towa-lcd-bias.dtsi"

