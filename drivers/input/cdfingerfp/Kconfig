## drivers/input/cdfingerfp/Kconfig
```kconfig
config CDFINGER_FP
	tristate "cdfinger fingerprint drvier support"
	help
	  Say Y here to enable cdfinger] fingerprint driver support!
```

## drivers/input/fingerprint/Kconfig
```kconfig
config FINGERPRINT_SUNWAVECORP
       tristate "Sunwave Fingerprint"
       default n
       help
          SUNWAVECORP Fingerprint
```

## drivers/usb/wusb3801x/Kconfig
```kconfig
#
# USB Miscellaneous driver configuration
#
comment "USB Miscellaneous drivers"


config USB_CC_WUSB3801X
	bool "IGC WUSB3801X Configuration Channel Controller for USB Type-C"
	depends on USB || I2C
	default n
	help
	  Enable this to support WUSB3801X CC Controller for USB Type C.



config DUAL_ROLE_USB_INTF
        bool "IGC WUSB3801X Configuration Channel Controller for USB Type-C"
        depends on USB || I2C
        default n
        help
          Enable this to support WUSB3801X CC Controller for USB Type C.
```
